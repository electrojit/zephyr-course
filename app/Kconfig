## app/Kconfig
```kconfig
menuconfig LED_SUBSYSTEM
    bool "LED Subsystem"
    default y
    help
      Enable the LED subsystem.

if LED_SUBSYSTEM

    choice LED_BLINK_SLEEP_TIME
        prompt "LED blink sleep time"
        default LED_BLINK_SLEEP_1S
        help
            Select the LED blink sleep interval.

        config LED_BLINK_SLEEP_250MS
            bool "250 ms (very fast)"

        config LED_BLINK_SLEEP_500MS
            bool "500 ms (fast)"

        config LED_BLINK_SLEEP_1S
            bool "1s (medium)"

        config LED_BLINK_SLEEP_2S
            bool "2s (slow)"

    endchoice


    # Derived numeric value for application code
    config BLINK_SLEEP_TIME_MS
        int
        default 500  if LED_BLINK_SLEEP_500MS
        default 1000 if LED_BLINK_SLEEP_1S
        default 2000 if LED_BLINK_SLEEP_2S
        help
            Derived blink interval in milliseconds based on the preset selection.


    menu "Advanced LED settings"

    config LED_BRIGHTNESS
        int "LED brightness (0-100)"
        default 100
        range 0 100
        help
            LED brightness percentage.

    config LED_FADE_DURATION_MS
        int "LED fade duration (ms)"
        default 500
        range 0 10000
        help
            Time in milliseconds for LED fade in/out.

        menu "Expert settings"

            config LED_DEBUG
                bool "Enable LED debugging"
                default n
                help
                    Enable verbose debugging for the LED subsystem.

            config LED_CUSTOM_BLINK_PATTERN
                bool "Custom blink pattern"
                default n
                help
                    Enable support for user-defined LED blink patterns.

        endmenu # Expert settings

    endmenu # Advanced LED settings

endif # LED_SUBSYSTEM

source "Kconfig.zephyr"
```
